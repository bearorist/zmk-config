## config/boards/shields/MB17/Kconfig.defconfig
```kconfig
# Copyright (c) 2022 The ZMK Contributors
# SPDX-License-Identifier: MIT

if SHIELD_MB17

config ZMK_KEYBOARD_NAME
  default "MB17"

endif 
```

## config/boards/shields/MB17/Kconfig.shield
```kconfig
# Copyright (c) 2022 The ZMK Contributors
# SPDX-License-Identifier: MIT

config SHIELD_MB17
  def_bool $(shields_list_contains,MB17)
```
